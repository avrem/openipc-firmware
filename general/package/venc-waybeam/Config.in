## general/package/venc-waybeam/Config.in
```kconfig
config BR2_PACKAGE_VENC_WAYBEAM
	bool "venc streamer"
	help
	  Yet another streamer for FPV projects.

	  https://github.com/OpenIPC/waybeam_venc
```
